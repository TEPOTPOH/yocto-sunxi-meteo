## conf/distro/cubieboard-meteo-rtl8821cu.conf
```bitbake
# Distro with RTL8821CU USB WIFI/BT driver

require cubieboard-meteo.conf

DISTRO = "cubieboard-meteo-rtl8821cu"
DISTRO_NAME = "Cubieboard meteo (Yocto Project based Distro) with RTL8821CU WIFI/BT driver"

DISTRO_FEATURES:append = " rtl8821cu wifi bluetooth"
```

## conf/distro/cubieboard-meteo.conf
```bitbake
# Create our own distro by subclassing a poky distro.
require conf/distro/poky.conf

DISTRO = "cubieboard-meteo"
DISTRO_NAME = "Cubieboard meteo (Yocto Project based Distro)"
DISTRO_VERSION = "1.0.0+snapshot-${METADATA_REVISION}"

SDK_VERSION = "${@d.getVar('DISTRO_VERSION').replace('snapshot-${METADATA_REVISION}', 'snapshot')}"
SDK_VERSION[vardepvalue] = "${SDK_VERSION}"

MAINTAINER = "tero <tepotpoh@gmail.com>"

IMAGE_FSTYPES = "sunxi-sdimg"

DISTRO_FEATURES:remove = " 3g nfc"
```

## conf/layer.conf
```bitbake
# We have a conf and classes directory, add to BBPATH
BBPATH .= ":${LAYERDIR}"

# We have recipes-* directories, add to BBFILES
BBFILES += "${LAYERDIR}/recipes-*/*/*.bb \
            ${LAYERDIR}/recipes-*/*/*.bbappend"

BBFILE_COLLECTIONS += "meta-meteo"
BBFILE_PATTERN_meta-meteo = "^${LAYERDIR}/"
BBFILE_PRIORITY_meta-meteo = "6"

LAYERDEPENDS_meta-meteo = "core meta-sunxi rust-bin-layer"
LAYERSERIES_COMPAT_meta-meteo = "kirkstone"
```
